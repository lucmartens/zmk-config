## config/boards/shields/kyria_custom_rev2/Kconfig.defconfig
```kconfig
if SHIELD_KYRIA_CUSTOM_REV2_LEFT

config ZMK_KEYBOARD_NAME
    default "Kyria"

config ZMK_SPLIT_BLE_ROLE_CENTRAL
    default y

endif


if SHIELD_KYRIA_CUSTOM_REV2_LEFT || SHIELD_KYRIA_CUSTOM_REV2_RIGHT

config ZMK_SPLIT
    default y

endif
```

## config/boards/shields/kyria_custom_rev2/Kconfig.shield
```kconfig
config SHIELD_KYRIA_CUSTOM_REV2_LEFT
    def_bool $(shields_list_contains,kyria_custom_rev2_left)

config SHIELD_KYRIA_CUSTOM_REV2_RIGHT
    def_bool $(shields_list_contains,kyria_custom_rev2_right)
```
